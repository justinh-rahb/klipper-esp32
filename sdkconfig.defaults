## sdkconfig.defaults
```kconfig
# Copyright (C) 2026 Justin Hayes <justinh@rahb.ca> (ESP32-family modifications)
# Distributed under the terms of the GNU GPLv3 license.

# FreeRTOS tick rate required by Klipper
CONFIG_FREERTOS_HZ=1000

# Main application stack and production watchdog behavior
CONFIG_ESP_MAIN_TASK_STACK_SIZE=8192
CONFIG_ESP_TASK_WDT_EN=y
CONFIG_ESP_TASK_WDT_INIT=y
CONFIG_ESP_TASK_WDT_PANIC=y
CONFIG_ESP_TASK_WDT_TIMEOUT_S=5

# Never mix ESP-IDF text logs with the Klipper binary protocol transport.
CONFIG_ESP_CONSOLE_NONE=y
CONFIG_ESP_CONSOLE_SECONDARY_NONE=y
CONFIG_LOG_DEFAULT_LEVEL_NONE=y
CONFIG_BOOTLOADER_LOG_LEVEL_NONE=y

# Shared Klipper buffers. Transport selection lives in the board profiles.
CONFIG_KLIPPER_CONSOLE_RX_BUFFER_SIZE=4096
```
